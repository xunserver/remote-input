## firmware/components/device/Kconfig
```kconfig
menu "Input Device"

config INPUT_WS_ENABLED
    bool "Enable WebSocket input receiver"
    default y
    select HTTPD_WS_SUPPORT
    select HTTPD_WS_POST_HANDSHAKE_CB_SUPPORT
    help
        Start a WiFi SoftAP and WebSocket endpoint for browser-based
        Input protocol frames.

config INPUT_WIFI_AP_SSID
    string "WebSocket SoftAP SSID"
    default "Input-S3"
    depends on INPUT_WS_ENABLED

config INPUT_WIFI_AP_PASSWORD
    string "WebSocket SoftAP WPA2 password"
    default "input"
    depends on INPUT_WS_ENABLED
    help
        WPA2 password for the SoftAP. Must be at least 8 characters.

config INPUT_WIFI_AP_CHANNEL
    int "WebSocket SoftAP channel"
    range 1 13
    default 6
    depends on INPUT_WS_ENABLED

config INPUT_WS_MAX_CLIENTS
    int "Maximum WebSocket clients"
    range 1 4
    default 1
    depends on INPUT_WS_ENABLED

config INPUT_DISPLAY_ENABLED
    bool "Enable LCD status display"
    default n
    help
        Enable the LVGL status screen for boards that already initialize
        LCD hardware, LVGL tick handling, display flushing, and the LVGL
        timer loop before input_service_init() runs.

        Keep this disabled on builds without a board-level LVGL port.

endmenu
```

## firmware/components/remote_input_device/Kconfig
```kconfig
menu "Remote Input Device"

config REMOTE_INPUT_WS_ENABLED
    bool "Enable WebSocket input receiver"
    default y
    select HTTPD_WS_SUPPORT
    select HTTPD_WS_POST_HANDSHAKE_CB_SUPPORT
    help
        Start a WiFi SoftAP and WebSocket endpoint for browser-based
        Remote Input protocol frames.

config REMOTE_INPUT_WIFI_AP_SSID
    string "WebSocket SoftAP SSID"
    default "Remote-Input-S3"
    depends on REMOTE_INPUT_WS_ENABLED

config REMOTE_INPUT_WIFI_AP_PASSWORD
    string "WebSocket SoftAP WPA2 password"
    default "remoteinput"
    depends on REMOTE_INPUT_WS_ENABLED
    help
        WPA2 password for the SoftAP. Must be at least 8 characters.

config REMOTE_INPUT_WIFI_AP_CHANNEL
    int "WebSocket SoftAP channel"
    range 1 13
    default 6
    depends on REMOTE_INPUT_WS_ENABLED

config REMOTE_INPUT_WS_MAX_CLIENTS
    int "Maximum WebSocket clients"
    range 1 4
    default 1
    depends on REMOTE_INPUT_WS_ENABLED

config REMOTE_INPUT_DISPLAY_ENABLED
    bool "Enable LCD status display"
    default n
    help
        Enable the LVGL status screen for boards that already initialize
        LCD hardware, LVGL tick handling, display flushing, and the LVGL
        timer loop before remote_input_service_init() runs.

        Keep this disabled on builds without a board-level LVGL port.

endmenu
```

## firmware/sdkconfig.defaults
```kconfig
CONFIG_IDF_TARGET="esp32s3"
CONFIG_BT_ENABLED=y
CONFIG_BT_NIMBLE_ENABLED=y
CONFIG_BT_NIMBLE_ROLE_PERIPHERAL=y
CONFIG_BT_NIMBLE_MAX_CONNECTIONS=1
CONFIG_TINYUSB_HID_COUNT=1
CONFIG_LOG_DEFAULT_LEVEL_INFO=y
CONFIG_REMOTE_INPUT_WS_ENABLED=y
CONFIG_REMOTE_INPUT_WIFI_AP_SSID="Remote-Input-S3"
CONFIG_REMOTE_INPUT_WIFI_AP_PASSWORD="remoteinput"
CONFIG_REMOTE_INPUT_WIFI_AP_CHANNEL=6
CONFIG_REMOTE_INPUT_WS_MAX_CLIENTS=1
CONFIG_HTTPD_WS_SUPPORT=y
CONFIG_REMOTE_INPUT_DISPLAY_ENABLED=y
# The firmware only uses LVGL core widgets; compiling bundled examples adds
# hundreds of source files to clean builds.
CONFIG_LV_BUILD_EXAMPLES=n
CONFIG_PARTITION_TABLE_SINGLE_APP_LARGE=y
```
